## sdkconfig.defaults
```kconfig
# ESP32 WiFi Manager - Default Configuration

CONFIG_ESP32C3_TARGET=y
CONFIG_IDF_TARGET="esp32c3"

# WiFi Configuration
CONFIG_ESP_WIFI_SSID="ESP32-Config"
CONFIG_ESP_WIFI_PASSWORD="config123"
CONFIG_ESP_WIFI_CHANNEL=1
CONFIG_ESP_WIFI_MAX_STA_CONN=4
CONFIG_ESP_DEFAULT_WIFI_MODE_AP=y

# HTTP Server
CONFIG_HTTPD_MAX_REQ_HDR_LEN=1024
CONFIG_HTTPD_MAX_URI_LEN=512

# NVS
CONFIG_NVS_ENCRYPTION=n

# Logging
CONFIG_LOG_DEFAULT_LEVEL_INFO=y

# FreeRTOS
CONFIG_FREERTOS_HZ=1000
```
